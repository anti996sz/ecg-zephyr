## boards/arm/yasun_mbe18/Kconfig.board
```kconfig
# Copyright (c) 2021 Nordic Semiconductor ASA
# SPDX-License-Identifier: Apache-2.0

config BOARD_YASUN_MBE18
	bool "yasun mbe18"
	depends on SOC_NRF5340_CPUAPP_QKAA

config BOARD_NRF5340DK_NRF5340_CPUNET
	bool "nRF5340 DK NRF5340 Network MCU"
	depends on SOC_NRF5340_CPUNET_QKAA
```

## boards/arm/yasun_mbe18/Kconfig.defconfig
```kconfig
# Copyright (c) 2021 Nordic Semiconductor ASA
# SPDX-License-Identifier: Apache-2.0

if BOARD_YASUN_MBE18

config BOARD
	default "yasun_mbe18"


endif
```

## boards/arm/yasun_mbe18/yasun_mbe18_defconfig
```kconfig
# Copyright (c) 2021 Nordic Semiconductor ASA
# SPDX-License-Identifier: Apache-2.0

CONFIG_SOC_SERIES_NRF53X=y
CONFIG_SOC_NRF5340_CPUAPP_QKAA=y
CONFIG_BOARD_YASUN_MBE18=y

# Enable MPU
CONFIG_ARM_MPU=y

# Enable hardware stack protection
CONFIG_HW_STACK_PROTECTION=y

# Enable TrustZone-M
CONFIG_ARM_TRUSTZONE_M=y
```

## boards/arm/ys_mbe07/Kconfig.board
```kconfig
# Copyright (c) 2021 Nordic Semiconductor ASA
# SPDX-License-Identifier: Apache-2.0

config BOARD_YS_MBE07
	bool "ys_mbe07"
	depends on SOC_NRF52832_QFAA
```

## boards/arm/ys_mbe07/Kconfig.defconfig
```kconfig
# Copyright (c) 2021 Nordic Semiconductor ASA
# SPDX-License-Identifier: Apache-2.0

if BOARD_YS_MBE07

config BOARD
	default "ys_mbe07"

config BT_CTLR
   default BT

endif
```

## drivers/zephyr/sensor/ads129xr/Kconfig
```kconfig
menuconfig ADS129XR
	bool "ADS1294R/ADS1298R ECG sensor"
	depends on SPI
	help
	  Enable driver for ADS129XR SPI-based ECG sensor.

if ADS129XR

config ADS129XR_THREAD_PRIORITY
	int "Own thread priority"
	default 10
	help
	  Priority of the thread used by the driver to handle interrupts.

config ADS129XR_THREAD_STACK_SIZE
	int "Own thread stack size"
	default 1024
	help
	  Stack size of thread used by the driver to handle interrupts.

endif # ADS129XR
```
